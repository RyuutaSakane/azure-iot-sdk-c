## Kconfig
```kconfig
#
# For a description of the syntax of this configuration file,
# see the file kconfig-language.txt in the NuttX tools repository.
#

config EXTERNALS_AZURE_IOT_SDK_C
	bool "azure-iot-sdk-c"
	default n
	---help---
		later.
```
